## CMakeLists.txt
```
# SPDX-License-Identifier: BSD-3-Clause

cmake_minimum_required(VERSION 3.20.0)
find_package(Zephyr REQUIRED HINTS $ENV{ZEPHYR_BASE})
project(test-mrubyc-zephyr-hal)

# Note: mrubyc autogen files are already generated manually
# To regenerate: cd mrubyc && PATH=/opt/homebrew/opt/ruby@3.3/bin:$PATH make autogen

target_sources(app PRIVATE
    src/main.c
    mrubyc/src/alloc.c
    mrubyc/src/c_array.c
    mrubyc/src/c_hash.c
    mrubyc/src/c_math.c
    mrubyc/src/c_numeric.c
    mrubyc/src/c_object.c
    mrubyc/src/c_proc.c
    mrubyc/src/c_range.c
    mrubyc/src/c_string.c
    mrubyc/src/class.c
    mrubyc/src/console.c
    mrubyc/src/error.c
    mrubyc/src/global.c
    mrubyc/src/keyvalue.c
    mrubyc/src/load.c
    mrubyc/src/mrblib.c
    mrubyc/src/rrt0.c
    mrubyc/src/symbol.c
    mrubyc/src/value.c
    mrubyc/src/vm.c
    mrubyc/hal/zephyr/hal.c
)

target_include_directories(app PRIVATE
    ${CMAKE_CURRENT_SOURCE_DIR}/mrubyc/src
    ${CMAKE_CURRENT_SOURCE_DIR}/mrubyc/hal/zephyr
    ${CMAKE_CURRENT_SOURCE_DIR}/src/rb
)
```

## prj.conf
```kconfig
#
# Copyright (c) 2021 Nordic Semiconductor
#
# SPDX-License-Identifier: LicenseRef-Nordic-5-Clause
#

####################
# Build
####################
CONFIG_CPP=n
CONFIG_DEBUG_OPTIMIZATIONS=n
CONFIG_SIZE_OPTIMIZATIONS=y
CONFIG_PICOLIBC=y
CONFIG_TIMEOUT_64BIT=n
CONFIG_FPU=y
CONFIG_COMPILER_OPT="-D_DEFAULT_SOURCE -DMRBC_SCHEDULER_EXIT=1 -DMRBC_USE_FLOAT=1 -DMRBC_USE_MATH=1 -DMAX_VM_COUNT=5 -DMRBC_NO_TIMER=1" # mruby/c VM settings (NOTIMER mode)

####################
# Thread
####################
CONFIG_TIMESLICING=y
CONFIG_TIMESLICE_SIZE=10
CONFIG_TIMESLICE_PRIORITY=0

####################
# Clock
####################
CONFIG_CLOCK_CONTROL_NRF_K32SRC_RC=y
CONFIG_CLOCK_CONTROL_NRF_K32SRC_XTAL=n
CONFIG_CLOCK_CONTROL_NRF_K32SRC_500PPM=y
CONFIG_CLOCK_CONTROL_NRF_K32SRC_SYNTH=n

#########################
# DEBUG
####################
CONFIG_DEBUG=y
CONFIG_CONSOLE=y
CONFIG_UART_CONSOLE=n
CONFIG_STDOUT_CONSOLE=n
CONFIG_EARLY_CONSOLE=y
CONFIG_RTT_CONSOLE=y
CONFIG_USE_SEGGER_RTT=y
CONFIG_PRINTK=y
#CONFIG_PRINTK_SYNC=y
CONFIG_REQUIRES_FLOAT_PRINTF=y
CONFIG_CBPRINTF_NANO=n
CONFIG_CBPRINTF_LIBC_SUBSTS=n
```

## src/main.c
```c
#include <stdint.h>
#include <stdio.h>
#include <string.h>
#include <emscripten.h>
#include "mrubyc.h"

#if !defined(MRBC_MEMORY_SIZE)
#define MRBC_MEMORY_SIZE 131072
#endif

#define MIN_BYTECODE_SIZE 8
#define MAX_BYTECODE_SIZE (1024 * 1024)

static uint8_t memory_pool[MRBC_MEMORY_SIZE];
static int initialized = 0;

static void write_text(int fd, const char *message)
{
  hal_write(fd, message, (int)strlen(message));
  hal_flush(fd);
}

EMSCRIPTEN_KEEPALIVE
void mrbc_wasm_init(void)
{
  if (!initialized) {
    mrbc_init(memory_pool, MRBC_MEMORY_SIZE);
    initialized = 1;
  }
}

static void reset_vm(void)
{
  if (initialized) {
    mrbc_cleanup();
    initialized = 0;
  }
  mrbc_wasm_init();
}

EMSCRIPTEN_KEEPALIVE
int mrbc_wasm_run(const uint8_t *bytecode, int size)
{
  char buffer[128];

  if (bytecode == NULL) {
    write_text(2, "Bytecode pointer is NULL.\n");
    return -1;
  }

  if (size < MIN_BYTECODE_SIZE) {
    snprintf(buffer, sizeof(buffer), "Bytecode is too small: %d bytes.\n", size);
    write_text(2, buffer);
    return -2;
  }

  if (size > MAX_BYTECODE_SIZE) {
    snprintf(buffer, sizeof(buffer), "Bytecode is too large: %d bytes.\n", size);
    write_text(2, buffer);
    return -3;
  }

  if (bytecode[0] != 'R' || bytecode[1] != 'I' || bytecode[2] != 'T' || bytecode[3] != 'E') {
    write_text(2, "Invalid mruby bytecode.\n");
    return -4;
  }

  if (!initialized) {
    mrbc_wasm_init();
  }

  if (mrbc_create_task(bytecode, NULL) == NULL) {
    write_text(2, "Failed to create mruby/c task.\n");
    reset_vm();
    return -5;
  }

  int ret = mrbc_run();
  hal_flush(1);
  hal_flush(2);
  reset_vm();

  return ret == 1 ? 0 : ret;
}
```
